#include <stdint.h>
#include <avr/pgmspace.h>
#include <avr/interrupt.h>
#include "display.h"
#include "mygccdef.h"
#include "main.h"

Disp_data Disp_send;
uint8_t   u8CursorX, u8CursorY;

// System 3x6 (char #20 to #96) 
const uint8_t Fonts[] PROGMEM = {
    0x00,0x00,0x00, // Space                // 0x20 Valid ASCII characters from here
    0x00,0x2E,0x00, // !
    0x06,0x00,0x06, // "
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    0x32,0x2A,0x26, // Z
};

// Clear display buffer
void clr_display(void) {
    for(uint16_t i=0; i<DISPLAY_DATA_SIZE; i++) Disp_send.display_data[i]=0;
    lcd_goto(0,0);
}

// OR byte on display buffer
void write_display(uint8_t data) {
    Disp_send.display_data[((uint16_t)(u8CursorY<<7)) + (u8CursorX++)] |= data;
}

/*-------------------------------------------------------------------------------
Print a char on the LCD
	GLCD_Putchar (uint8_t u8Char)
		u8Char = char to display
-------------------------------------------------------------------------------*/
void GLCD_Putchar(char u8Char) {
    uint16_t pointer;
	uint8_t data,u8CharColumn=0;
	pointer = (unsigned int)(Fonts)+(u8Char-0x20)*(3);
    if(u8Char!='\n') {
       	/* Draw a char */
    	while (u8CharColumn < 3)	{
            data = pgm_read_byte_near(pointer++);
		    write_display(data);
		    u8CharColumn++;
	    }
    }
    if(u8CursorX < 128) {  // if not then insert a space before next letter
		data = 0;
		write_display(data);
	}
    if(u8CursorX>=128 || u8Char=='\n') {    // Next line
        u8CursorX = 0; u8CursorY++;
    }
}

// Print Number
void printN(uint8_t Data) {
    uint8_t d=0x30;
	while (Data>=100)	{ d++; Data-=100; }
    GLCD_Putchar(d);
	d=0x30;
	while (Data>=10)	{ d++; Data-=10; }
    GLCD_Putchar(d);
    GLCD_Putchar(Data+0x30);
}

// Print small font text at x,y from program memory
void tiny_printp(uint8_t x, uint8_t y, const char *ptr) {
    lcd_goto(x,y);
    char c;
    while ((c=pgm_read_byte(ptr++)) != 0x00) GLCD_Putchar(c);
}
